/**
 * @cliArgs --board "/ti/boards/CC1312R1_LAUNCHXL" --device "CC1312R1F3RGZ" --part "Default" --package "RGZ" --rtos "freertos" --product "simplelink_cc13xx_cc26xx_sdk@8.30.01.01"
 * @versions {"tool":"1.21.1+3772"}
 */

/**
 * Import the modules used in this configuration.
 */
const FreeRTOS = scripting.addModule("/freertos/FreeRTOS");
const CCFG     = scripting.addModule("/ti/devices/CCFG");
const custom   = scripting.addModule("/ti/devices/radioconfig/custom");
const rfdesign = scripting.addModule("/ti/devices/radioconfig/rfdesign");
const GPIO     = scripting.addModule("/ti/drivers/GPIO");
const GPIO1    = GPIO.addInstance();
const GPIO2    = GPIO.addInstance();
const RF       = scripting.addModule("/ti/drivers/RF");
const UART2    = scripting.addModule("/ti/drivers/UART2", {}, false);
const UART21   = UART2.addInstance();
const Settings = scripting.addModule("/ti/posix/freertos/Settings");

/**
 * Write custom configuration values to the imported modules.
 */
CCFG.enableBootloader        = true;
CCFG.dioBootloaderBackdoor   = 13;
CCFG.levelBootloaderBackdoor = "Active low";
CCFG.ccfgTemplate.$name      = "ti_devices_CCFG_CCFGCC26XXTemplate0";

custom.prop8                                                  = ["2gfsk1mbps868"];
custom.radioConfig2gfsk1mbps868.$name                         = "ti_devices_radioconfig_settings_prop0";
custom.radioConfig2gfsk1mbps868.txPower                       = "12.5";
custom.radioConfig2gfsk1mbps868.codeExportConfig.$name        = "ti_devices_radioconfig_code_export_param0";
custom.radioConfig2gfsk1mbps868.codeExportConfig.cmdList_prop = ["cmdFs","cmdPropRadioDivSetup","cmdPropRx","cmdPropRxAdv","cmdPropTx","cmdPropTxAdv"];

GPIO1.$hardware = system.deviceData.board.components.LED_RED;
GPIO1.$name     = "CONFIG_GPIO_RLED";

GPIO2.$hardware = system.deviceData.board.components.LED_GREEN;
GPIO2.$name     = "CONFIG_GPIO_GLED";

UART21.$name     = "CONFIG_UART2_0";
UART21.$hardware = system.deviceData.board.components.XDS110UART;

/**
 * Pinmux solution for unlocked pins/peripherals. This ensures that minor changes to the automatic solver in a future
 * version of the tool will not impact the pinmux you originally saw.  These lines can be completely deleted in order to
 * re-solve from scratch.
 */
GPIO1.gpioPin.$suggestSolution     = "boosterpack.39";
GPIO2.gpioPin.$suggestSolution     = "boosterpack.40";
UART21.uart.$suggestSolution       = "UART0";
UART21.uart.txPin.$suggestSolution = "boosterpack.4";
UART21.uart.rxPin.$suggestSolution = "boosterpack.3";
